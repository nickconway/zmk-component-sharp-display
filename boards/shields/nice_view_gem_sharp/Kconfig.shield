## boards/shields/sharp_display/Kconfig.defconfig
```kconfig
if SHIELD_SHARP_DISPLAY

config LV_Z_VDB_SIZE
    default 100

config LV_DPI_DEF
    default 161

config LV_Z_BITS_PER_PIXEL
    default 1

choice LV_COLOR_DEPTH
    default LV_COLOR_DEPTH_1
endchoice

choice ZMK_DISPLAY_WORK_QUEUE
    default ZMK_DISPLAY_WORK_QUEUE_DEDICATED
endchoice

choice ZMK_DISPLAY_STATUS_SCREEN
    default ZMK_DISPLAY_STATUS_SCREEN_CUSTOM
endchoice

config LV_Z_MEM_POOL_SIZE
    default 8192 if ZMK_DISPLAY_STATUS_SCREEN_CUSTOM

config ZMK_DISPLAY_STATUS_SCREEN_CUSTOM
    imply SHARP_DISPLAY_WIDGET_STATUS

config SHARP_DISPLAY_WIDGET_STATUS
    bool "Sharp display widget status"
    select LV_USE_LABEL
    select LV_USE_IMAGE
    select LV_USE_CANVAS
    select LV_USE_ANIMIMG
    select LV_USE_ANIMATION

config SHARP_DISPLAY_INVERTED
    bool "Invert display colors"
    default n

config SHARP_DISPLAY_CUSTOM_SCREEN
    bool "Sharp custom screen"
    default n

if !ZMK_SPLIT || ZMK_SPLIT_ROLE_CENTRAL

config SHARP_DISPLAY_WIDGET_STATUS
    bool "Sharp display widget status"
    select ZMK_WPM

endif # !ZMK_SPLIT || ZMK_SPLIT_ROLE_CENTRAL

endif # SHIELD_SHARP_DISPLAY
```
